## Kconfig
```kconfig
config ZMK_INPUT_STREAM_FEATURE
    bool "Enable input stream feature"

if ZMK_INPUT_STREAM_FEATURE

config ZMK_INPUT_STREAM_FEATURE_STUDIO_RPC
    bool "Enable input stream custom Studio RPC"
    depends on ZMK_STUDIO
    select ZMK_LOW_PRIORITY_WORK_QUEUE

if ZMK_INPUT_STREAM_FEATURE_STUDIO_RPC

config ZMK_INPUT_STREAM_NOTIF_QUEUE_SIZE
    int "Max queued notifications"
    default 8
    help
      Maximum number of key/layer notifications buffered between the event
      handler and the low-priority sender. Excess notifications are dropped.

config ZMK_INPUT_STREAM_LEASE_MS
    int "Input stream client lease (ms)"
    default 15000
    range 10000 120000
    help
      Expire a stream unless its owning epoch is renewed within this time.
      The Web client renews every two seconds. A timer revokes authorization
      and purges queued reports even while the sender is blocked. Older
      viewers must implement renewal or their streams expire after one lease.

endif # ZMK_INPUT_STREAM_FEATURE_STUDIO_RPC

endif # ZMK_INPUT_STREAM_FEATURE

config ZMK_INPUT_STREAM_FORK_LOG_LEVEL
    int "zmk-input-stream-fork log level (0 off, 1 error, 2 warning, 3 info, 4 debug)"
    range 0 4
    default 3
    help
      Logs contain operational state and numeric diagnostics, never input
      contents, user labels, peer addresses or authentication material.
```
